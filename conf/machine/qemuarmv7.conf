## conf/machine/qemuarmv7.conf
```bitbake
#@TYPE: Machine
#@NAME: eagle
#@DESCRIPTION: eagle

require conf/machine/include/qemu.inc
include conf/machine/include/tune-cortexa8.inc

KERNEL_IMAGETYPE = "zImage"

SERIAL_CONSOLES = "115200;ttyAMA0 115200;ttyAMA1"
```

## conf/machine/qemuarmv7a.conf
```bitbake
#@TYPE: Machine
#@NAME: eagle
#@DESCRIPTION: eagle

require conf/machine/include/qemu.inc
require conf/machine/include/arm/arch-armv7a.inc

KERNEL_IMAGETYPE = "zImage"

SERIAL_CONSOLES = "115200;ttyAMA0 115200;ttyAMA1"
```
